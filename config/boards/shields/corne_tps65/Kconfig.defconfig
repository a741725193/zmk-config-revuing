## config/boards/shields/corne_tps65/Kconfig.defconfig
```kconfig
# Copyright (c) 2025 The ZMK Contributors
# SPDX-License-Identifier: MIT

if SHIELD_CORNE_TPS65_LEFT

config ZMK_KEYBOARD_NAME
    default "Corne TPS65"

config ZMK_SPLIT_ROLE_CENTRAL
    default y

endif

if SHIELD_CORNE_TPS65_RIGHT

config ZMK_KEYBOARD_NAME
    default "Corne TPS65"

# TPS65 sensor is enabled via driver Kconfig

endif

if SHIELD_CORNE_TPS65_LEFT || SHIELD_CORNE_TPS65_RIGHT

config ZMK_SPLIT
    default y

# Disable USB logging to avoid split keyboard conflicts
# config ZMK_USB_LOGGING
#     default y

endif 

if SHIELD_CORNE_TPS65_LEFT

config ZMK_KEYBOARD_NAME
    default "Corne TPS65"

config ZMK_SPLIT_ROLE_CENTRAL
    default y

endif

if SHIELD_CORNE_TPS65_RIGHT

config ZMK_KEYBOARD_NAME
    default "Corne TPS65"

# TPS65 sensor is enabled via driver Kconfig

endif

if SHIELD_CORNE_TPS65_LEFT || SHIELD_CORNE_TPS65_RIGHT

config ZMK_SPLIT
    default y

# Disable USB logging to avoid split keyboard conflicts
# config ZMK_USB_LOGGING
#     default y

endif 

config ZMK_SENSOR_TPS65
	bool "Azoteq TPS65 trackpad driver"
	default y
	depends on DT_HAS_AZOTEQ_TPS65_ENABLED
	select I2C
	select SENSOR
	help
	  Enable driver for Azoteq TPS65 trackpad sensor.

if ZMK_SENSOR_TPS65

config ZMK_SENSOR_TPS65_GESTURE_SUPPORT
	bool "Gesture support"
	default n
	help
	  Enable gesture support.

config ZMK_SENSOR_TPS65_POLL_RATE_MS
	int "Poll rate (ms)"
	default 10
	help
	  The time between sensor polls in milliseconds.

config ZMK_SENSOR_TPS65_MAX_TOUCHES
	int "Max touches"
	default 5
	help
	  The maximum number of touches to report.

config ZMK_SENSOR_TPS65_SENSITIVITY
	int "Sensitivity"
	default 40
	help
	  The sensitivity of the sensor.

endif
```
